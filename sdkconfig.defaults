## sdkconfig.defaults
```kconfig
# Defender Dashboard - ESP-IDF Configuration
# Target: Waveshare ESP32-S3-Touch-LCD-4.3B-BOX (SKU 28141)

CONFIG_IDF_TARGET="esp32s3"
CONFIG_ESP_DEFAULT_CPU_FREQ_MHZ_240=y
CONFIG_ESPTOOLPY_FLASHMODE_QIO=y
CONFIG_ESPTOOLPY_FLASHFREQ_80M=y
CONFIG_ESPTOOLPY_FLASHSIZE_16MB=y

# PSRAM (8MB Octal)
CONFIG_SPIRAM=y
CONFIG_SPIRAM_MODE_OCT=y
CONFIG_IDF_EXPERIMENTAL_FEATURES=y
CONFIG_SPIRAM_SPEED_80M=y
CONFIG_SPIRAM_FETCH_INSTRUCTIONS=y
CONFIG_SPIRAM_RODATA=y

# Cache
CONFIG_ESP32S3_DATA_CACHE_LINE_64B=y
CONFIG_ESP32S3_DATA_CACHE_LINE_SIZE=64

# FreeRTOS
CONFIG_FREERTOS_HZ=1000

# Console
CONFIG_ESP_CONSOLE_USB_SERIAL_JTAG=y

# Watchdog - extended for boot with splash screen
CONFIG_ESP_TASK_WDT_TIMEOUT_S=10

# LVGL display
CONFIG_EXAMPLE_LVGL_PORT_TASK_CORE=1
CONFIG_EXAMPLE_LVGL_PORT_AVOID_TEAR_ENABLE=y

# LVGL config
CONFIG_LV_COLOR_SCREEN_TRANSP=y
CONFIG_LV_MEM_CUSTOM=y
CONFIG_LV_MEMCPY_MEMSET_STD=y
CONFIG_LV_USE_LOG=y
CONFIG_LV_LOG_PRINTF=y
CONFIG_LV_USE_PERF_MONITOR=n
CONFIG_LV_ATTRIBUTE_FAST_MEM_USE_IRAM=y

# LVGL fonts - only include what we use (custom fonts handle the rest)
CONFIG_LV_FONT_MONTSERRAT_14=y
CONFIG_LV_USE_FONT_COMPRESSED=y
CONFIG_LV_USE_IMGFONT=y

# Demos disabled
CONFIG_LV_USE_DEMO_WIDGETS=n
CONFIG_LV_USE_DEMO_BENCHMARK=n
CONFIG_LV_USE_DEMO_STRESS=n
CONFIG_LV_USE_DEMO_MUSIC=n

# CAN bus GPIO
CONFIG_EXAMPLE_TX_GPIO_NUM=15
CONFIG_EXAMPLE_RX_GPIO_NUM=16
```
